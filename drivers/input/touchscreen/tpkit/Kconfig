## drivers/input/touchscreen/tpkit/Kconfig
```kconfig
#
# huawei touchscreen driver configuration
#

menuconfig HUAWEI_TS_KIT
	tristate "huawei TS_KIT drivers"
	default n
	help
	  If you say yes here you get support for huawei touchscreen.
menuconfig HUAWEI_TS_KIT_COMMON
	bool "huawei TS_KIT common"
	default n
	help
	  If you say yes here you get support for huawei touchscreen.

source "drivers/input/tpkit/panel/Kconfig"
```

## drivers/input/touchscreen/tpkit/panel/Kconfig
```kconfig
#
# huawei touchscreen driver configuration
#

# source "drivers/input/tpkit/panel/synaptics/Kconfig"
source "drivers/input/tpkit/panel/synaptics_tcm/Kconfig"
```

## drivers/input/touchscreen/tpkit/panel/omnivision_tcm/Kconfig
```kconfig
#
# Omnivision TCM touchscreen driver configuration
#
menuconfig OMNIVISION_TCM_TS_KIT
	tristate "Omnivision TCM touchscreen"
	default n
	help
	  Say Y here if you have a Omnivision TCM touchscreen connected
	  to your system.

	  If unsure, say N.
```
