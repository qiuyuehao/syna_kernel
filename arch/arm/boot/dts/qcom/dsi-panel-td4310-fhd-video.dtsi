/* Copyright (c) 2013, The Linux Foundation. All rights reserved.
 *
 * This program is free software; you can redistribute it and/or modify
 * it under the terms of the GNU General Public License version 2 and
 * only version 2 as published by the Free Software Foundation.
 *
 * This program is distributed in the hope that it will be useful,
 * but WITHOUT ANY WARRANTY; without even the implied warranty of
 * MERCHANTABILITY or FITNESS FOR A PARTICULAR PURPOSE.  See the
 * GNU General Public License for more details.
 */

/*---------------------------------------------------------------------------
 * This file is autogenerated file using gcdb parser. Please do not edit it.
 * Update input XML file to add a new entry or update variable in this file
 * VERSION = "1.0"
 *---------------------------------------------------------------------------*/
&mdss_mdp {
	dsi_td4310_fhd_video: qcom,mdss_dsi_td4310_fhd_video {
		qcom,mdss-dsi-panel-name = "td4310 fhd video mode dsi panel";
		qcom,mdss-dsi-panel-controller = <&mdss_dsi0>;
		qcom,mdss-dsi-panel-type = "dsi_video_mode";
		qcom,mdss-dsi-panel-destination = "display_1";
		qcom,mdss-dsi-panel-framerate = <60>;
		qcom,mdss-dsi-virtual-channel-id = <0>;
		qcom,mdss-dsi-stream = <0>;
		qcom,mdss-dsi-panel-width = <1080>;
		qcom,mdss-dsi-panel-height = <1920>;
		qcom,mdss-dsi-h-front-porch = <156>;
		qcom,mdss-dsi-h-back-porch = <120>;
		qcom,mdss-dsi-h-pulse-width = <40>;
		qcom,mdss-dsi-h-sync-skew = <0>;
		qcom,mdss-dsi-v-back-porch = <3>;
		qcom,mdss-dsi-v-front-porch = <15>;
		qcom,mdss-dsi-v-pulse-width = <1>;
		qcom,mdss-dsi-h-left-border = <0>;
		qcom,mdss-dsi-h-right-border = <0>;
		qcom,mdss-dsi-v-top-border = <0>;
		qcom,mdss-dsi-v-bottom-border = <0>;
		qcom,mdss-dsi-bpp = <24>;
		qcom,mdss-dsi-color-order = "rgb_swap_rgb";
		qcom,mdss-dsi-underflow-color = <0xff>;
		qcom,mdss-dsi-border-color = <0>;
		qcom,mdss-dsi-on-command = [29 01 00 00 00 00 02 b0 00
			29 01 00 00 00 00 04 b3 01 00 06
			29 01 00 00 00 00 02 b4 00
			29 01 00 00 00 00 06 b6 33 5b 81 12 00
			29 01 00 00 00 00 08 b8 57 3d 19 1e 0a 50 50
			29 01 00 00 00 00 08 b9 6f 3d 28 3c 14 c8 c8
			29 01 00 00 00 00 08 ba b5 33 41 64 23 a0 a0
			29 01 00 00 00 00 03 bb 14 14
			29 01 00 00 00 00 03 bc 37 32
			29 01 00 00 00 00 03 bd 64 32
			29 01 00 00 00 00 02 be 04
			29 01 00 00 00 00 02 c0 00
			29 01 00 00 00 00 31 c1 04 40 00 00 26 15 19 0B 63 B2 D9 9A 73 EF BD E7 5C 6B 93 4E 22 18 8B 2A 41 00 00 00 00 00 00 00 00 00 40 02 22 1B 06 03 00 0F FF 00 01 00 00 00
			29 01 00 00 00 00 19 c2 01 F7 80 12 66 06 0C 10 00 08 30 00 00 00 00 00 00 00 00 08 00 00 00 00
			29 01 00 00 00 00 3f c3 78 77 87 78 70 00 00 00 00 00 3b 63 b6 00 00 3f c3 fc 00 00 01 01 03 28 00 01 00 01 00 00 00 00 00 00 00 00 00 00 00 00 00 00 00 00 00 00 00 00 2c 00 2c 00 5a 02 00 00 00 00 00 00 40 00
			29 01 00 00 00 00 15 c4 70 00 00 00 00 00 00 00 00 02 02 31 01 00 00 00 02 01 01 01           
			29 01 00 00 00 00 09 c5 08 00 00 00 00 70 00 00
			29 01 00 00 00 00 40 c6 46 24 24 03 45 03 45 01 02 01 02 04 04 00 00 04 04 07 10 04 47 00 8E 61 00 00 00 00 00 00 00 00 00 00 00 00 00 00 00 00 00 00 00 00 00 00 00 00 00 00 00 00 00 00 00 00 00 00 00 00 00 00 00
			29 01 00 00 00 00 27 c7 00 0d 1b 35 45 50 60 6b 75 7f 30 3a 44 54 5f 6f 7c 8a 97 00 0d 1b 35 45 50 60 6b 75 7f 30 3a 44 54 5f 6f 7c 8a 97
			29 01 00 00 00 00 38 c8 00 00 00 00 00 fc 00 00 00 00 00 fc 00 00 00 00 00 fc 00 00 00 00 00 fc 00 00 00 00 00 fc 00 00 00 00 00 fc 00 00 00 00 00 fc 00 00 00 00 00 fc 00 00 00 00 00 fc 00
			29 01 00 00 00 00 14 c9 00 00 00 00 00 fc 00 00 00 00 00 fc 00 00 00 00 00 fc 00
			29 01 00 00 00 00 2c ca 1c fc fc fc 00 00 00 00 00 00 00 00 00 00 00 00 00 00 00 00 00 00 00 00 00 00 00 00 00 00 00 00 00 00 00 00 00 00 00 00 00 00 00
			29 01 00 00 00 00 1c cb FF FF FF FF 0F 00 08 00 01 00 31 F0 40 08 00 00 00 00 00 00 00 00 00 00 00 00 00    
			29 01 00 00 00 00 03 cc 33 00
			29 01 00 00 00 00 27 cd 1D 00 22 00 22 00 5c 02 ae ae a0 a0 a0 a0 a0 a0 01 00 00 00 2b 00 2b 00 5d 02 24 24 01 2c 00 2c 00 5e 02 24 24 a2
			29 01 00 00 00 00 1a ce 5d 40 49 53 59 5e 63 68 6e 74 7e 8a 98 a8 bb d0 ff 04 00 04 04 42 00 69 5a
			29 01 00 00 00 00 03 cf 4a 1d
			29 01 00 00 00 00 14 d0 33 57 d7 31 01 10 10 10 19 19 00 00 00 00 00 00 00 6d 65
			29 01 00 00 00 00 02 d1 00
			29 01 00 00 00 00 16 d3 1b 3b bb 77 77 77 bb b3 33 00 00 6d 6e bf bf 33 bb f2 fd c6 0b
			29 01 00 00 00 00 0b d5 03 00 00 02 37 02 37 01 00 00
			29 01 00 00 00 00 02 d6 c1
			29 01 00 00 00 00 22 d7 f6 ff 03 05 41 24 80 1f c7 1f 1b 00 0c 07 20 00 00 00 00 00 0c 00 1f 00 fc 00 00 ab 67 7e 5d 26 00
			29 01 00 00 00 00 08 d9 00 16 14 3f 0f 57 07
			29 01 00 00 00 00 05 dd 30 06 23 65
			29 01 00 00 00 00 05 de 00 3f ff 90
			29 01 00 00 00 00 02 ea 1f
			29 01 00 00 00 00 04 ee 41 51 00
			29 01 00 00 00 00 04 f1 00 00 00
			29 01 00 00 00 00 02 b0 03
			39 01 00 00 00 00 02 51 ff
			39 01 00 00 00 00 02 53 0c
			39 01 00 00 00 00 02 55 00
			05 01 00 00 ff 00 02 11 00
			05 01 00 00 14 00 02 29 00];
		qcom,mdss-dsi-off-command = [05 01 00 00 00 00 02 28 00
			05 01 00 00 00 00 02 10 00];
		qcom,mdss-dsi-on-command-state = "dsi_lp_mode";
		qcom,mdss-dsi-off-command-state = "dsi_hs_mode";
		qcom,mdss-dsi-h-sync-pulse = <1>;
		qcom,mdss-dsi-traffic-mode = "burst_mod";
		qcom,mdss-dsi-lane-map = "lane_map_0123";
		qcom,mdss-dsi-bllp-eof-power-mode;
		qcom,mdss-dsi-bllp-power-mode;
		qcom,mdss-dsi-lane-0-state;
		qcom,mdss-dsi-lane-1-state;
		qcom,mdss-dsi-lane-2-state;
		qcom,mdss-dsi-lane-3-state;
		qcom,mdss-dsi-panel-timings = [FE 3C 2A 00 70 74 2E 40 30 03 04 00];
		qcom,mdss-dsi-t-clk-post = <0x02>;
		qcom,mdss-dsi-t-clk-pre = <0x2E>;
		qcom,mdss-dsi-bl-min-level = <1>;
		qcom,mdss-dsi-bl-max-level = <4095>;
		qcom,mdss-dsi-dma-trigger = "trigger_sw";
		qcom,mdss-dsi-mdp-trigger = "none";
		qcom,mdss-dsi-bl-pmic-control-type = "bl_ctrl_wled";
		qcom,mdss-dsi-reset-sequence = <1 20>, <0 20>, <1 200>;
	};
};
