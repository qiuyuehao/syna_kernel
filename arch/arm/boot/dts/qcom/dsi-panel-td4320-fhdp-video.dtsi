/* Copyright (c) 2013, The Linux Foundation. All rights reserved.
 *
 * This program is free software; you can redistribute it and/or modify
 * it under the terms of the GNU General Public License version 2 and
 * only version 2 as published by the Free Software Foundation.
 *
 * This program is distributed in the hope that it will be useful,
 * but WITHOUT ANY WARRANTY; without even the implied warranty of
 * MERCHANTABILITY or FITNESS FOR A PARTICULAR PURPOSE.  See the
 * GNU General Public License for more details.
 */

/*---------------------------------------------------------------------------
 * This file is autogenerated file using gcdb parser. Please do not edit it.
 * Update input XML file to add a new entry or update variable in this file
 * VERSION = "1.0"
 *---------------------------------------------------------------------------*/
&mdss_mdp {
	dsi_td4320_fhdp_video: qcom,mdss_dsi_td4320_fhdp_video {
		qcom,mdss-dsi-panel-name = "td4320 fhdp video mode dsi panel";
		qcom,mdss-dsi-panel-controller = <&mdss_dsi0>;
		qcom,mdss-dsi-panel-type = "dsi_video_mode";
		qcom,mdss-dsi-panel-destination = "display_1";
		qcom,mdss-dsi-panel-framerate = <60>;
		qcom,mdss-dsi-virtual-channel-id = <0>;
		qcom,mdss-dsi-stream = <0>;
		qcom,mdss-dsi-panel-width = <1080>;
		qcom,mdss-dsi-panel-height = <2340>;
		qcom,mdss-dsi-h-front-porch = <108>;
		qcom,mdss-dsi-h-back-porch = <40>;
		qcom,mdss-dsi-h-pulse-width = <2>;
		qcom,mdss-dsi-h-sync-skew = <0>;
		qcom,mdss-dsi-v-back-porch = <60>;
		qcom,mdss-dsi-v-front-porch = <4>;
		qcom,mdss-dsi-v-pulse-width = <4>;
		qcom,mdss-dsi-h-left-border = <0>;
		qcom,mdss-dsi-h-right-border = <0>;
		qcom,mdss-dsi-v-top-border = <0>;
		qcom,mdss-dsi-v-bottom-border = <0>;
		qcom,mdss-dsi-bpp = <24>;
		qcom,mdss-dsi-color-order = "rgb_swap_rgb";
		qcom,mdss-dsi-underflow-color = <0xff>;
		qcom,mdss-dsi-border-color = <0>;
		qcom,mdss-dsi-on-command = [29 01 00 00 00 00 02 b0 00
		29 01 00 00 00 00 07 b6 30 6a 00 06 c3 03
		29 01 00 00 00 00 05 b7 31 00 00 00
		29 01 00 00 00 00 07 b8 00 78 64 10 64 b4
		29 01 00 00 00 00 07 b9 00 78 64 10 64 b4
		29 01 00 00 00 00 07 ba 00 78 64 10 64 b4
		29 01 00 00 00 00 04 bb 00 b4 a0
		29 01 00 00 00 00 04 bc 00 b4 a0
		29 01 00 00 00 00 04 bd 00 b4 a0
		29 01 00 00 00 00 0e be 07 00 00 00 00 00 00 00 00 00 00 00 00
		29 01 00 00 00 00 19 c0 00 60 10 06 4c 03 93 0d 82 00 70 00 00 00 00 00 00 00 00 00 00 00 00 00
		29 01 00 00 00 00 28 c1 30 11 50 fa 01 00 00 10 00 00 00 00 40 0f 00 00 00 00 00 00 00 00 00 00 00 00 00 00 00 00 00 00 f0 07 08 07 d0 0a be
		29 01 00 00 00 00 f5 c2 05 f0 38 14 05 10 0c 00 00 00 00 00 00 00 00 00 00 00 00 00 00 00 00 00 00 00 00 00 00 00 00 00 00 00 00 00 00 00 00 00 00 00 05 00 50 08 08 05 00 c5 00 80 00 00 00 00 00 00 00 00 00 11 00 00 00 00 00 00 00 00 00 00 00 00 00 00 00 00 00 00 00 00 00 00 00 00 00 00 00 00 00 00 00 11 00 00 00 00 00 00 00 00 00 00 00 00 00 00 00 00 00 00 00 00 00 00 00 00 00 00 00 00 00 00 00 11 00 00 00 00 00 00 00 00 00 00 00 00 00 00 00 00 00 00 00 00 00 00 00 00 00 00 00 00 00 00 00 11 00 00 00 00 00 00 00 00 00 00 00 00 00 00 00 00 00 00 00 00 00 00 00 00 00 00 00 00 00 00 00 00 00 00 00 00 00 00 00 10 00 00 00 00 00 00 00 00 00 00 00 00 00 00 00 02 00 00 00 00 00 00 00 00 00 00 02 00 00 00 00 00 00 00 00 00 00 00 00 00 00 00 00 00 00 00
		29 01 00 00 00 00 6a c3 00 00 65 c1 00 d0 05 00 00 00 20 00 00 00 00 00 00 00 00 00 00 00 20 00 00 00 00 00 00 00 00 00 00 00 20 00 00 00 00 00 00 00 00 00 00 00 20 00 00 00 00 08 00 00 00 00 00 00 00 00 00 00 00 00 00 00 00 00 00 00 00 00 00 00 00 00 00 00 00 00 00 00 00 00 00 00 00 00 00 00 00 00 00 00 00 00 00 00 00 00 00 00 00 00 00
		29 01 00 00 00 00 55 c4 00 00 68 61 03 05 67 13 15 17 19 00 00 00 00 00 00 00 00 00 00 00 00 00 00 00 00 00 00 00 00 00 00 00 00 1a 18 16 14 67 06 04 61 68 00 00 00 00 00 00 00 c0 03 00 00 3c 00 00 00 00 00 00 00 00 00 00 00 00 00 5a 5a 00 00 55 55 55 55 55 55 55 55 55 55 55
		29 01 00 00 00 00 06 c5 08 00 00 00 00
		29 01 00 00 00 00 4d c6 00 00 00 00 01 22 04 22 01 00 61 00 00 00 01 00 61 00 01 05 01 0b 01 35 ff 8f 06 05 01 c0 0f 00 00 00 00 00 00 00 00 00 00 00 00 00 00 00 00 00 00 00 00 00 00 20 20 00 00 00 c0 11 00 00 00 10 10 00 00 00 01 00 50 00 33 03 00 00
		29 01 00 00 00 00 1f cb 02 d0 01 80 00 00 00 00 00 00 00 00 00 00 00 00 00 00 00 00 00 00 40 70 00 00 00 00 00 ff
		29 01 00 00 00 00 19 ce 5d 40 43 49 55 62 71 82 94 a8 b9 cb db e9 f5 fc ff 04 00 04 04 00 00 00
		29 01 00 00 00 00 02 cf 00
		29 01 00 00 00 00 15 d0 c1 46 81 66 09 90 00 cc f2 ff 11 46 06 7e 09 08 cc 1b f0 06
		29 01 00 00 00 00 26 d1 d0 d0 1b 33 33 17 07 bb 33 33 33 33 00 3b 77 07 3b 30 06 72 33 13 00 d7 0c 33 02 00 18 70 18 77 11 11 11 20 20
		29 01 00 00 00 00 04 d2 00 00 00
		29 01 00 00 00 00 9a d3 00 00 00 00 00 00 00 00 00 ff f7 ff ff f7 ff ff f7 ff ff f7 ff ff f7 ff ff f7 ff ff f7 ff ff f7 ff ff f7 ff ff f7 ff ff f7 ff ff f7 ff ff f7 ff ff f7 ff ff f7 ff ff f7 ff ff f7 ff ff f7 ff ff f7 ff ff f7 ff ff f7 ff ff f7 ff ff f7 ff ff f7 ff ff f7 ff ff f7 ff ff f7 ff ff f7 ff ff f7 ff ff f7 ff ff f7 ff ff f7 ff ff f7 ff ff f7 ff ff f7 ff ff f7 ff ff f7 ff ff f7 ff ff f7 ff ff f7 ff ff f7 ff ff f7 ff ff f7 ff ff f7 ff ff f7 ff ff f7 ff ff f7 ff ff f7 ff
		29 01 00 00 00 00 18 d4 00 00 00 00 00 00 00 00 00 20 00 00 00 00 20 00 00 00 00 00 00 00 00
		29 01 00 00 00 00 2f d7 01 00 12 12 00 62 03 93 00 62 03 93 03 83 80 85 85 85 87 84 45 86 87 80 88 86 89 83 83 87 84 88 8a 0c 0b 0a 0a 0a 07 07 06 06 00 08 0a 0a
		29 01 00 00 00 00 17 d8 40 99 26 ed 16 6c 16 6c 16 6c 00 14 00 14 00 14 01 0c 00 00 01 00
		29 01 00 00 00 00 29 d9 00 02 7f 00 00 00 00 00 00 00 00 00 00 00 00 c0 00 00 00 00 00 00 00 00 00 00 00 00 00 00 00 00 00 00 00 00 00 00 00 00
		29 01 00 00 00 00 05 dd 30 06 23 65
		29 01 00 00 00 00 0f de 00 00 00 0f ff 00 00 00 00 10 00 00 00 00
		29 01 00 00 00 00 09 e6 00 00 00 00 00 0e 00 00
		29 01 00 00 00 00 24 ea 02 07 07 04 80 10 01 00 00 00 00 03 23 00 07 00 ed 00 ed 00 ed 01 28 01 28 00 62 00 62 00 62 01 0f 01 00
		29 01 00 00 00 00 09 eb 06 e0 6e 06 e1 01 08 00
		29 01 00 00 00 00 18 ec 02 d0 01 70 73 10 01 00 00 00 00 02 2a 00 00 00 00 00 00 00 00 00 00
		29 01 00 00 00 00 22 ed 01 02 00 00 00 00 00 00 9e ca 62 00 00 00 00 00 00 00 00 00 00 00 01 b0 01 00 00 00 00 00 41 10 01
		29 01 00 00 00 00 7a ee 05 00 05 00 c0 17 00 00 03 00 00 03 00 00 03 00 c0 17 00 00 00 00 00 00 03 00 00 00 00 00 00 03 00 00 00 00 00 00 03 00 00 00 00 00 00 03 40 d5 03 00 00 00 00 00 00 03 00 00 00 00 00 00 03 00 00 00 00 00 00 03 00 00 00 00 00 00 03 00 00 03 00 00 03 00 00 03 00 00 03 00 00 03 00 00 03 00 40 15 00 00 00 00 00 14 00 00 00 00 00 00 00 00 00 00 00 00 00 00 00 00 12
		29 01 00 00 00 00 02 b0 03
		29 01 00 00 00 00 02 b0 04
		29 01 00 00 00 00 05 e5 03 00 00 00
		29 01 00 00 00 00 05 d5 01 4d 00 00
		29 01 00 00 00 00 32 c8 40 00 00 00 00 fc 00 00 00 00 00 fc 00 00 00 00 00 fc 00 00 00 00 00 fc 00 00 00 00 fc 00 00 00 00 fc 00 00 00 00 fc 00 00 00 00 fc 00 00 00 00 fc
		29 01 00 00 00 00 1a c9 00 00 00 00 fc 00 00 00 00 00 fc 00 00 00 00 00 fc 00 24 8b 4d 8b 4d 8b 4d
		29 01 00 00 00 00 45 ca 1c fc fc fc 00 00 00 00 00 00 00 00 00 00 00 00 00 00 00 00 00 00 00 00 00 00 00 00 00 00 00 00 00 00 00 00 00 00 00 00 00 00 00 00 00 00 00 00 00 00 00 00 00 00 00 00 00 00 00 00 00 00 00 00 00 40 00 00
		39 01 00 00 00 00 02 51 ff
		39 01 00 00 00 00 02 53 0c
		39 01 00 00 00 00 02 55 00
		29 01 00 00 00 00 02 b0 03
		05 01 00 00 ff 00 02 11 00
		05 01 00 00 ff 00 02 29 00];
		qcom,mdss-dsi-off-command = [05 01 00 00 00 00 02 28 00
			05 01 00 00 00 00 02 10 00];
		qcom,mdss-dsi-on-command-state = "dsi_lp_mode";
		qcom,mdss-dsi-off-command-state = "dsi_hs_mode";
		qcom,mdss-dsi-h-sync-pulse = <0>;
		qcom,mdss-dsi-traffic-mode = "burst_mode";
		qcom,mdss-dsi-lane-map = "lane_map_0123";
		qcom,mdss-dsi-bllp-eof-power-mode;
		qcom,mdss-dsi-bllp-power-mode;
		qcom,mdss-dsi-lane-0-state;
		qcom,mdss-dsi-lane-1-state;
		qcom,mdss-dsi-lane-2-state;
		qcom,mdss-dsi-lane-3-state;
		qcom,mdss-dsi-panel-timings = [f6 3c 28 00 6e 72 2e 40 62 03 04 00];
		qcom,mdss-dsi-t-clk-post = <0x02>;
		qcom,mdss-dsi-t-clk-pre = <0x33>;
		qcom,mdss-dsi-bl-min-level = <1>;
		qcom,mdss-dsi-bl-max-level = <4095>;
		qcom,mdss-dsi-dma-trigger = "trigger_sw";
		qcom,mdss-dsi-mdp-trigger = "none";
		qcom,mdss-dsi-bl-pmic-control-type = "bl_ctrl_wled";
		qcom,mdss-dsi-reset-sequence = <1 20>, <0 20>, <1 2000>;
	};
};
